## conf/layer.conf
```bitbake
# We have a conf and classes directory, add to BBPATH
BBPATH .= ":${LAYERDIR}"

# We have recipes-* directories, add to BBFILES
#BBFILES += "${LAYERDIR}/recipes-*/*/*.bb ${LAYERDIR}/recipes-*/*/*.bbappend"

BBFILE_COLLECTIONS += "license-tools"
BBFILE_PATTERN_license-tools = "^${LAYERDIR}/"
BBFILE_PRIORITY_license-tools = "1"

# This should only be incremented on significant changes that will
# cause compatibility issues with other layers
LAYERVERSION_license-tools = "1"

LAYERDEPENDS_license-tools = "core"

#LAYERSERIES_COMPAT_license-tools = "rocko"

# Used by fossology.bbclass
HOSTTOOLS_NONFATAL += "fossup"
```
